## config/west.yml
```yaml
manifest:
  remotes:
    - name: zmkfirmware
      url-base: https://github.com/zmkfirmware
  projects:
    - name: zmk
      remote: zmkfirmware
      revision: b26058b19ab69a9de7e39ac48a91086e59d1f27e
      import: app/west.yml
  self:
    path: config
```
